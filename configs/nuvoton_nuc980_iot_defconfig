## configs/nuvoton_nuc980_iot_defconfig
```kconfig
BR2_arm=y
BR2_DL_DIR="$(TOPDIR)/dl-buildroot-2016.11.1"
BR2_TOOLCHAIN_BUILDROOT_VENDOR="nuvoton"
BR2_PACKAGE_HOST_LINUX_HEADERS_CUSTOM_4_4=y
BR2_UCLIBC_CONFIG="board/nuvoton/uClibc-nuc980.config"
BR2_TOOLCHAIN_BUILDROOT_INET_RPC=y
BR2_TOOLCHAIN_BUILDROOT_LOCALE=y
BR2_PTHREAD_DEBUG=y
BR2_GCC_VERSION_4_8_X=y
BR2_TOOLCHAIN_BUILDROOT_CXX=y
BR2_PACKAGE_HOST_GDB=y
BR2_PACKAGE_HOST_GDB_PYTHON=y
BR2_ROOTFS_DEVICE_CREATION_DYNAMIC_EUDEV=y
BR2_ROOTFS_POST_BUILD_SCRIPT="board/nuvoton/install_nuc980_iot.sh"
BR2_LINUX_KERNEL=y
BR2_LINUX_KERNEL_CUSTOM_GIT=y
BR2_LINUX_KERNEL_CUSTOM_REPO_URL="https://github.com/OpenNuvoton/NUC980-linux-4.4.y.git"
BR2_LINUX_KERNEL_CUSTOM_REPO_VERSION="master"
BR2_LINUX_KERNEL_DEFCONFIG="nuc980_iot"
BR2_LINUX_KERNEL_UIMAGE=y
BR2_LINUX_KERNEL_DTS_SUPPORT=y
BR2_LINUX_KERNEL_INTREE_DTS_NAME="nuc980-iot-v1.0"
BR2_PACKAGE_BUSYBOX_CONFIG="board/nuvoton/busybox-nuc980.config"
BR2_PACKAGE_ALSA_UTILS=y
BR2_PACKAGE_BZIP2=y
BR2_PACKAGE_ZIP=y
BR2_PACKAGE_GDB=y
BR2_PACKAGE_UMTP_RESPONDER=y
BR2_PACKAGE_LIBPTHREAD_STUBS=y
BR2_PACKAGE_OPENSSH=y
BR2_PACKAGE_RSYNC=y
BR2_PACKAGE_INOTIFY_TOOLS=y
# BR2_TARGET_ROOTFS_TAR is not set
BR2_TARGET_ROOTFS_UBIFS=y
BR2_TARGET_ROOTFS_UBIFS_LEBSIZE=0x1f000
BR2_TARGET_ROOTFS_UBIFS_LZO=y
BR2_TARGET_ROOTFS_UBIFS_OPTS="-F"
BR2_TARGET_ROOTFS_UBI=y
BR2_TARGET_ROOTFS_UBI_SUBSIZE=2048
BR2_TARGET_ROOTFS_UBI_OPTS="-m 2048 -O 2048"
BR2_TARGET_UBOOT=y
BR2_TARGET_UBOOT_BUILD_SYSTEM_KCONFIG=y
BR2_TARGET_UBOOT_CUSTOM_GIT=y
BR2_TARGET_UBOOT_CUSTOM_REPO_URL="https://github.com/OpenNuvoton/NUC970_U-Boot_v2016.11.git"
BR2_TARGET_UBOOT_CUSTOM_REPO_VERSION="master"
BR2_TARGET_UBOOT_BOARD_DEFCONFIG="nuc980_iot"
BR2_TARGET_UBOOT_NEEDS_DTC=y
BR2_TARGET_UBOOT_SPL=y
```

## package/umtp-responder/Config.in
```kconfig
config BR2_PACKAGE_UMTP_RESPONDER
        bool "umtp responder"
        help
          https://github.com/viveris/uMTP-Responder
```
